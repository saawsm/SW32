## source/swef/main/Kconfig.projbuild
```kconfig
menu "swef Configuration"

    menu "LED Strip"    
        config SWEF_PIN_LED_STRIP
            int "LED Strip GPIO Number"
            default 2
            help
                Set the GPIO number for the LED strip.

        config SWEF_LED_STRIP_LENGTH
            int "LED Strip Length"
            default 10
            help
                Set the number of LEDs in the LED strip.
    endmenu

    menu "Rotary Encoder"
        config SWEF_PIN_ENC_A
            int "Rotary Encoder Pin A GPIO Number"
            default 16
            help
                Set the GPIO number for pin A of the rotary encoder.
            
        config SWEF_PIN_ENC_B
            int "Rotary Encoder Pin B GPIO Number"
            default 17
            help
                Set the GPIO number for pin B of the rotary encoder.
    
        config SWEF_PIN_ENC_BTN
            int "Rotary Encoder Button GPIO Number"
            default 4
            help
                Set the GPIO number used by the rotary encoder button.
    endmenu   
    
    menu "Buttons"
        config SWEF_PIN_BTN_TL
            int "Top Left Button GPIO Number"
            default 27
            help
                Set the GPIO number for the top left button.
                
        config SWEF_PIN_BTN_TR
            int "Top Right Button GPIO Number"
            default 26
            help
                Set the GPIO number for the top right button.
                
        config SWEF_PIN_BTN_BR
            int "Bottom Right Button GPIO Number"
            default 14
            help
                Set the GPIO number for the bottom right button
                
        config SWEF_PIN_BTN_BL
            int "Bottom Left Button GPIO Number"
            default 21
            help
                Set the GPIO number for the bottom left button.
    endmenu
    
    menu "Potentiometers"
        config SWEF_POT_CH1_ADC1_CH
            int "Channel 1 ADC Mapping"
            default 0
            help
                Set the ADC1 channel number for the output channel 1.

        config SWEF_POT_CH2_ADC1_CH
            int "Channel 2 ADC Mapping"
            default 3
            help
                Set the ADC1 channel number for the output channel 2.

        config SWEF_POT_CH3_ADC1_CH
            int "Channel 3 ADC Mapping"
            default 6
            help
                Set the ADC1 channel number for the output channel 3.

        config SWEF_POT_CH4_ADC1_CH
            int "Channel 4 ADC Mapping"
            default 7
            help
                Set the ADC1 channel number for the output channel 4.
    endmenu

    config SWEF_PIN_BUZZER
        int "Buzzer GPIO Number"
        default 12
        help
            Set the GPIO number for the buzzer.

    menu "Display Menu"
        config SWEF_MENU_LABEL_MAX_LENGTH
            int "Maximum Menu Label Length"
            default 32
            help
                Set the maximum character length for display items.

        config SWEF_MENU_STACK_COUNT
            int "Menu Stack Count"
            default 10
            help
                Set the maximum number of menus that can be stored in the menustack.
    endmenu

endmenu
```

## source/swef/sdkconfig.defaults
```kconfig
CONFIG_ESPTOOLPY_FLASHSIZE_16MB=y

CONFIG_PARTITION_TABLE_CUSTOM=y
CONFIG_PARTITION_TABLE_CUSTOM_FILENAME="partitions.csv"

CONFIG_SPIFFS_OBJ_NAME_LEN=64

# Button and encoder polling intervals
CONFIG_EBTN_POLLING_INTERVAL_MS_BTN=30
CONFIG_EBTN_POLLING_INTERVAL_US_ENC=2500

# HAGL
CONFIG_MIPI_DCS_ADDRESS_MODE_MIRROR_X=0x00
CONFIG_MIPI_DCS_ADDRESS_MODE_MIRROR_Y=0x80
CONFIG_MIPI_DCS_ADDRESS_MODE_MIRROR_Y_SELECTED=y

CONFIG_MIPI_DCS_ADDRESS_MODE_SWAP_XY_SELECTED=y
CONFIG_MIPI_DCS_ADDRESS_MODE_SWAP_XY=0x20

CONFIG_MIPI_DCS_ADDRESS_MODE_FLIP_X=0x00
CONFIG_MIPI_DCS_ADDRESS_MODE_FLIP_Y=0x00

CONFIG_MIPI_DCS_PIXEL_FORMAT_16BIT_SELECTED=y
CONFIG_MIPI_DISPLAY_PIXEL_FORMAT=0x55

CONFIG_HAGL_HAL_USE_DOUBLE_BUFFERING=y

CONFIG_MIPI_DISPLAY_WIDTH=160
CONFIG_MIPI_DISPLAY_HEIGHT=128
CONFIG_MIPI_DISPLAY_OFFSET_X=0
CONFIG_MIPI_DISPLAY_OFFSET_Y=0
CONFIG_MIPI_DISPLAY_INVERT=n

CONFIG_MIPI_DISPLAY_SPI_CLOCK_SPEED_HZ=48000000
CONFIG_MIPI_DISPLAY_EXCLUSIVE_BUS=n

CONFIG_MIPI_DISPLAY_PIN_MISO=19
CONFIG_MIPI_DISPLAY_PIN_MOSI=23
CONFIG_MIPI_DISPLAY_PIN_CLK=18
CONFIG_MIPI_DISPLAY_PIN_CS=5
CONFIG_MIPI_DISPLAY_PIN_DC=22
CONFIG_MIPI_DISPLAY_PIN_RST=0
CONFIG_MIPI_DISPLAY_PIN_BL=13
```
